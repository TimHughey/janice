## mcr_esp/components/mcr/Kconfig
```kconfig
menu "MCR"

config MG_ENABLE_SYNC_RESOLVER
	bool "Use Mongoose synchronous DNS resolver"
	default false

config MCR_ENV
	string "MCR Execution Environment"
	default "prod"
	help
		Build MCR for operation in a specific environment.

menu "Network"
	config WIFI_SSID
	    string "WiFi SSID"
		default "WissLanding"
		help
			SSID (network name)

	config WIFI_PASSWORD
	    string "WiFi Password"
		default "password"
		help
			WiFi password (WPA or WPA2)
	endmenu

menu "Engines"
	config MCR_CMD_Q_MAX_DEPTH
		int "Command Queue Maximum Depth"
		default 30
		range 10 50
		help
			A queue is used for commands sent via MQTT.  This parameter defines
			the maximum depth of the queue.

			This value should be greater than the number of expected devices
			that can receive commands (e.g. switches) in the event a command is
			sent for every device.

			Depending on the number of devices and speed of the network, it is very possible for commands to arrive faster than they can be executed on the relatively slow One-Wire Bus.

			The behaviour of command processing is UNDEFINED if this value is
			too low.  In other words, the command is likely silently dropped and
			not acknowledged.

	config MCR_DS_ENABLE
		bool "Enable the 1-Wire Engine"
		default y
		select MCR_DS_PHASES
		select MCR_DS_TASKS

		config MCR_W1_PIN
			depends on MCR_DS_ENABLE
			int "Bus GPIO Pin"
			default 14
			range 14 16
			help
				The GPIO pin used by RMT for One-Wire bus communications.

		config MCR_DS_PHASES
			depends on MCR_DS_ENABLE
			bool "1-Wire Phases"

			config MCR_DS_CONVERT_FREQUENCY_SECS
				depends on MCR_DS_PHASES
				int "Convert Frequency (seconds)"
				default 7
				range 3 600
				help
					How often to issue the temperature convert command to temperature capable
					devices on the 1-Wire bus

					Temperature capable devices will only be reported to the IoT endpoint
					once for each temperature convert.  Use this configuration value to indicate
					how often perform the temperature conversion.

					When temperature capable devices are available on the bus this value also
					controls how often all device readings are published to the IoT endpoint.

			config MCR_DS_DISCOVER_FREQUENCY_SECS
				depends on MCR_DS_PHASES
				int "Discover Frequency (seconds)"
				default 30
				range 3 600
				help
					How often to execute the 1-Wire search command on the 1-Wire bus

					Typically the 1-Wire bus is stable and there isn't a need to discover (search for)
					devices frequency.  This configuration controls often to find new devices.

			config MCR_DS_REPORT_FREQUENCY_SECS
				depends on MCR_DS_PHASES
				int "Report Frequency (seconds)"
				default 7
				range 3 600
				help
					How often to read the devices available on the 1-Wire bus and publish their
					readings to the IoT endpoint

					This configuration value is only used if no temperature capable devices are
					found on the 1-Wire bus.

			config MCR_DS_ENGINE_FREQUENCY_SECS
				depends on MCR_DS_PHASES
				int "Main Loop Frequency (seconds)"
				default 30
				range 3 600
				help
					How often to execute the housekeeping task for the 1-Wire bus engine

					As of now this loop only reports various metrics to the console.

			config MCR_DS_TEMP_CONVERT_POLL_MS
				depends on MCR_DS_PHASES
				int "Delay between polls to check if temperature convert is finished (ms)"
				default 50
				range 10 1000
				help
					How much to delay between checks that a temperature convert is complete

					To avoid busy waiting for the temperature capable devices to release the 1-Wire
					bus this value introduces a task delay between checks.

	config MCR_I2C_ENABLE
		bool "Enable the I2C Engine"
		default y
		select MCR_I2C_PHASES
		select MCR_I2C_TASKS

		config MCR_I2C_SCL_PIN
			depends on MCR_I2C_ENABLE
			int "SCL Pin"
			default 22
			range 22 22
			help
				The GPIO pin to use as I2C SCL.

		config MCR_I2C_SDA_PIN
			depends on MCR_I2C_ENABLE
			int "SDA Pin"
			default 23
			range 23 23
			help
				The GPIO pin to use as I2C SDA.

		config MCR_I2C_PHASES
			depends on MCR_I2C_ENABLE
			bool "I2C Phases"

			config MCR_I2C_DISCOVER_FREQUENCY_SECS
				depends on MCR_I2C_PHASES
				int "Discover Frequency (seconds)"
				default 30
				range 3 600
				help
					How often to scan the I2C bus for supported devics.

					Scanning the I2C bus can be an expensive operation especially when
					the hardware is configured with a multiplexer.

			config MCR_I2C_REPORT_FREQUENCY_SECS
				depends on MCR_I2C_PHASES
				int "Report Frequency (seconds)"
				default 7
				range 3 600
				help
					How often to read and report the known devices on the I2C bus.

			config MCR_I2C_ENGINE_FREQUENCY_SECS
				depends on MCR_I2C_PHASES
				int "Main Loop Frequency (seconds)"
				default 7
				range 3 600
				help
					How often to execute the housekeeping task for the I2C bus engine

					As of now this value controls how often all actions are performed
					by the I2C engine.

	endmenu

menu "IoT"
	config MCR_IOT_ENDPOINT
		bool "Use IoT Endpoint"
		default y
		select MCR_MQTT_CONFIG
		select MCR_IOT_TASKS

		config MCR_MQTT_CONFIG
			depends on MCR_IOT_ENDPOINT
			bool "Configure IoT Endpoint"
			default y


		config MCR_MQTT_HOST
			depends on MCR_MQTT_CONFIG
			string "IoT Endpoint Host"
			default "jophiel.wisslanding.com"
			help
				Endpoint host name for the IoT MQTT/S gateway

		config MCR_MQTT_PORT
			depends on MCR_MQTT_CONFIG
			int "IoT Endpoint Port"
			default 1883
			range 0 65535
			help
				Endpoint port for the IoT MQTT/S gateway

		config MCR_MQTT_USER
			depends on MCR_MQTT_CONFIG
			string "IoT Endpoint User"
			default "mqtt"
			help
				User name for connecting to the IoT MQTT/S gateway

		config MCR_MQTT_PASSWD
			depends on MCR_MQTT_CONFIG
			string "IoT Endpoint Password"
			default "mqtt"
			help
				Password for connecting to the IoT MQTT/S gateway

		config MCR_MQTT_RPT_FEED
			depends on MCR_MQTT_CONFIG
			string "Reporting Publish Topic (Feed)"
			default "prod/mcr/f/report"
			help
				Topic (feed) for reporting data from the MCR device to the IoT endpoint

		config MCR_MQTT_CMD_FEED
			depends on MCR_MQTT_CONFIG
			string "Command Subscribe Topic (Feed)"
			default "prod/mcr/f/command"
			help
				Topic (feed) for receiving commands from the IoT endpoint


			config MCR_MQTT_RINGBUFFER_PENDING_MSGS
				depends on MCR_IOT_TASKS
				int "Pending Messages"
				default 128
				range 12 256
				help
					The processing of inbound/outbound messages from/to the IoT endpoint are
					buffered between receiving and sending before being sent to the device or the endoint.

					This value configures how many pending messages are permitted.

			config MCR_MQTT_INBOUND_MSG_WAIT_MS
				depends on MCR_IOT_TASKS
				int "Wait for inbound messages (ms)"
				default 1
				range 0 1000
				help
					To avoid consuming excessive CPU the endpoint task will delay at two points:
					   1. Poll for inbound messages to process (this configuration value)
						 2. Wait for outbound messages to send

					This value configures how long (in milliseconds) to wait for an inbound message.

					It is advisable to match this value with the outbound message wait to best balance the
					processing of inbound and outbound messages.

			config MCR_MQTT_INBOUND_RB_WAIT_MS
				depends on MCR_IOT_TASKS
				int "How long to wait (in ms) for space if the inbound ringbuffer if full"
				default 1000
				range 0 5000
				help
					If the inbound ringbuffer becomes overloaded while processing MQTT
					messges wait this amount of time (in ms) for space to become free

					Use this value to create a throttle point when a flood of inbound MQTT
					occurs.  This situation is most likely to occur when the MCR has been
					offline for an extended period of time.


			config MCR_MQTT_OUTBOUND_MSG_WAIT_MS
				depends on MCR_IOT_TASKS
				int "Wait for outbound messages (ms)"
				default 30
				range 0 1000
				help
					To avoid consuming excessive CPU the endpoint task will delay at two points:
						 1. Poll for inbound messages to process
						 2. Wait for outbound messages to send (this configuration value)

					This value configures how long (in milliseconds) to wait for an outbound message.

					It is advisable to match this value with the inbound message wait to best balance the
					processing of inbound and outbound messages.
	endmenu

menu "Task Priorities"
	config MCR_TASK_PRIORITIES
		bool "Configure MCR Task Priorities"
		default y

		config MCR_DS_TASKS
			depends on MCR_DS_ENABLE && MCR_TASK_PRIORITIES
			bool "1-Wire"

		 	config MCR_DS_DISCOVER_TASK_PRIORITY
				depends on MCR_DS_TASKS && MCR_TASK_PRIORITIES
			 	int "Discover Task Priority"
			 	default 12
			 	range 1 19
			 	help
			 		The 1-Wire Engine is divided in multiple tasks:
			 			1. Core
			 			2. Discover (this configuration value)
			 			3. Convert
			 			4. Report
						5. Command

				 	 This configuration value defines the task priority of the Discover task.

					 It is advisable to set this priority lower than all other tasks except the
					 Core housekeeping task.

		 	config MCR_DS_CONVERT_TASK_PRIORITY
				depends on MCR_DS_TASKS && MCR_TASK_PRIORITIES
	 		 int "Convert Task Priority"
	 		 default 13
	 		 range 1 19
	 		 help
	 			 The 1-Wire Engine is divided in multiple tasks:
	 				 1. Core
	 				 2. Discover
	 				 3. Convert (this configuration value)
	 				 4. Report
	 				 5. Command

		 			This configuration value defines the task priority of the Convert task.

		 			It is advisable to set this priority to match the Report priority and
					higher than other tasks but lower than the Command task.

			config MCR_DS_REPORT_TASK_PRIORITY
				depends on MCR_DS_TASKS && MCR_TASK_PRIORITIES
				int "Report Task Priority"
				default 13
				range 1 19
				help
				 The 1-Wire Engine is divided in multiple tasks:
					 1. Core
					 2. Discover
					 3. Convert
					 4. Report (this configuration value)
					 5. Command

					This configuration value defines the task priority of the Report task.

					It is advisable to match this priority to the Convert task.

			config MCR_DS_COMMAND_TASK_PRIORITY
				depends on MCR_DS_TASKS && MCR_TASK_PRIORITIES
				int "Command Task Priority"
				default 14
				range 1 19
				help
				 The 1-Wire Engine is divided in multiple tasks:
					 1. Core
					 2. Discover
					 3. Convert
					 4. Report
					 5. Command (this configuration value)

					This configuration value defines the task priority of the Command task.

					It is advisable to set this priority the highest of all 1-Wire Engine tasks
					to ensure handling commands (e.g. changing a switch position) swiftly.

		config MCR_I2C_TASKS
			depends on MCR_I2C_ENABLE && MCR_TASK_PRIORITIES
			bool "I2C"

			config MCR_I2C_DISCOVER_TASK_PRIORITY
				depends on MCR_I2C_TASKS && MCR_TASK_PRIORITIES
			 	int "Discover Task Priority"
			 	default 12
			 	range 1 19
			 	help
			 		The I2C Engine is divided in multiple tasks:
			 			1. Core
			 			2. Discover (this configuration value)
			 			3. Report
						4. Command

				 	 This configuration value defines the task priority of the Discover task.

					 It is advisable to set this priority lower than all other tasks except the
					 Core housekeeping task.

			config MCR_I2C_REPORT_TASK_PRIORITY
				depends on MCR_I2C_TASKS && MCR_TASK_PRIORITIES
				int "Report Task Priority"
				default 13
				range 1 19
				help
				 The I2C Engine is divided in multiple tasks:
					 1. Core
					 2. Discover
					 3. Report (this configuration value)
					 4. Command

					This configuration value defines the task priority of the Report task.

			config MCR_I2C_COMMAND_TASK_PRIORITY
				depends on MCR_I2C_TASKS && MCR_TASK_PRIORITIES
				int "Command Task Priority"
				default 14
				range 1 19
				help
				 The I2C Engine is divided in multiple tasks:
					 1. Core
					 2. Discover
					 3. Report
					 4. Command (this configuration value)

					This configuration value defines the task priority of the Command task.

					It is advisable to set this priority the highest of all I2C Engine tasks
					to ensure handling commands (e.g. changing a switch position) swiftly.

		 config MCR_IOT_TASKS
	 		depends on MCR_IOT_ENDPOINT && MCR_TASK_PRIORITIES
	 		bool "IoT"
	 		default y

	 		config MCR_MQTT_TASK_PRIORITY
	 			depends on MCR_TASK_PRIORITIES && MCR_IOT_TASKS
	 			int "Send/Receive Task Priority"
	 			default 14
	 			range 1 19
	 			help
	 				MQTT processing is divided into two tasks:
	 					1. Sending and receiving all MQTT messages (this configuration value)
	 					2. Processing messages (e.g. parsing JSON) to hand-off to Engine tasks for action

	 				This value configures the priority of the sending and receiving task.

	 				It is advisable for this task to be a higher priority than the inbound processing
	 				task to ensure that messages are overall sent and received with minimal delay.

	 		config MCR_MQTT_INBOUND_TASK_PRIORITY
	 			depends on MCR_TASK_PRIORITIES && MCR_IOT_TASKS
	 			int "Inbound Processing Task Priority"
	 			default 10
	 			range 1 19
	 			help
	 				MQTT processing is divided into two tasks:
	 					1. Sending and receiving all MQTT messages
	 					2. Processing messages (e.g. parsing JSON) to hand-off to Engine tasks for action
	 						 (this configuration value)

	 				This value configures the priority processing task.

	 				It is advisable for this task to be a lower priority than the sending and receiving
	 				task to avoid delays in sending and receiving.

 endmenu

endmenu
```
